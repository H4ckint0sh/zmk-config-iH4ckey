## config/boards/shields/iH4ckey/Kconfig.defconfig
```kconfig
if SHIELD_IH4CKEY_LEFT

config ZMK_KEYBOARD_NAME
    default "iH4ckey"

config ZMK_SPLIT_ROLE_CENTRAL
    default y

endif

if SHIELD_IH4CKEY_LEFT || SHIELD_IH4CKEY_RIGHT

config ZMK_SPLIT
    default y

endif
```

## config/boards/shields/iH4ckey/Kconfig.shield
```kconfig
config SHIELD_IH4CKEY_LEFT
    def_bool $(shields_list_contains,iH4ckey_left)

config SHIELD_IH4CKEY_RIGHT
    def_bool $(shields_list_contains,iH4ckey_right)
```
